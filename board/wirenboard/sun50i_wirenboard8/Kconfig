## board/wirenboard/sun50i_wirenboard8/Kconfig
```kconfig
if TARGET_SUN50I_WIRENBOARD8

config SYS_BOARD
    default "sun50i_wirenboard8"

config SYS_VENDOR
    default "wirenboard"

config SYS_CONFIG_NAME
    default "sun50i_wirenboard8"

config OF_OVERLAY_ADDR
    hex

config OF_OVERLAY_OFFSET_BLKS
    hex

config OF_OVERLAY_SIZE_BLKS
    hex

choice
prompt "WB8 flavour"

config WB8_FLAVOUR_GENERIC
    bool "Generic Wiren Board 8"

endchoice

endif
```

## configs/sun50i_wirenboard8_defconfig
```kconfig
CONFIG_ARM=y
CONFIG_ARM_SMCCC=y
CONFIG_ARCH_SUNXI=y
CONFIG_ENV_SIZE=0xC000
CONFIG_DEFAULT_DEVICE_TREE="sun50i-h616-wirenboard8xx"
CONFIG_SPL=y
CONFIG_BOOTSTAGE_STASH_ADDR=0
CONFIG_DRAM_SUN50I_H616_DX_ODT=0x07070707
CONFIG_DRAM_SUN50I_H616_DX_DRI=0x0e0e0e0e
CONFIG_DRAM_SUN50I_H616_CA_DRI=0x0e0e
CONFIG_DRAM_SUN50I_H616_ODT_EN=0xaaaaeeee
CONFIG_DRAM_SUN50I_H616_TPR6=0x44000000
CONFIG_DRAM_SUN50I_H616_TPR10=0x402f6633
CONFIG_DRAM_SUN50I_H616_TPR11=0x24242624
CONFIG_DRAM_SUN50I_H616_TPR12=0x0f0f100f
CONFIG_MACH_SUN50I_H616=y
CONFIG_SUNXI_DRAM_T507_LPDDR4=y
CONFIG_DRAM_CLK=792
CONFIG_TARGET_SUN50I_WIRENBOARD8=y
CONFIG_MMC_SUNXI_SLOT_EXTRA=2
CONFIG_R_I2C_ENABLE=y
# CONFIG_PSCI_RESET is not set
CONFIG_CHECK_AUTH=y
# CONFIG_SYS_MALLOC_CLEAR_ON_INIT is not set
CONFIG_ANDROID_BOOT_IMAGE=y
CONFIG_AUTOBOOT_KEYED=y
CONFIG_AUTOBOOT_PROMPT="Hit <SPACE> to stop autoboot... (%d s)\n"
CONFIG_AUTOBOOT_STOP_STR=" "
CONFIG_LOGLEVEL=9
CONFIG_SYS_DEVICE_NULLDEV=y
CONFIG_SPL_I2C=y
# CONFIG_SYS_MMCSD_FS_BOOT is not set
CONFIG_CMD_ABOOTIMG=y
# CONFIG_OF_TAG_MIGRATE is not set
# CONFIG_ENV_IS_IN_FAT is not set
CONFIG_ENV_IS_IN_MMC=y
CONFIG_SYS_MMC_ENV_DEV=1
CONFIG_SPL_SYS_I2C_LEGACY=y
CONFIG_SYS_I2C_MVTWSI=y
CONFIG_SYS_I2C_SLAVE=0x36
CONFIG_SYS_MMC_MAX_BLK_COUNT=1
CONFIG_REGULATOR_AXP=y
# CONFIG_DM_REGULATOR_FIXED is not set
CONFIG_AXP15060_POWER=y
CONFIG_AXP_DCDC1_VOLT=3300
CONFIG_AXP_DCDC2_VOLT=900
CONFIG_AXP_DCDC3_VOLT=940
CONFIG_AXP_DCDC4_VOLT=900
CONFIG_AXP_DCDC5_VOLT=1100
CONFIG_AXP_ALDO1_VOLT=1800
CONFIG_AXP_ALDO2_VOLT=1800
CONFIG_AXP_ALDO3_VOLT=0
CONFIG_AXP_ALDO4_VOLT=1800
CONFIG_AXP_SW_ON=y
# CONFIG_EFI_LOADER is not set
CONFIG_SPI=y
CONFIG_SPI_SUNXI=y
CONFIG_CMD_SPI=y
CONFIG_DEFAULT_SPI_BUS=0
CONFIG_DEFAULT_SPI_MODE=0x0
CONFIG_CMD_SQUASHFS=y
CONFIG_FS_SQUASHFS=y
```
